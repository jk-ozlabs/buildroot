## configs/sl_checkin_defconfig
```kconfig
BR2_powerpc64le=y
BR2_GENERATE_LOCALE="en_US.UTF-8"
BR2_ROOTFS_DEVICE_CREATION_DYNAMIC_EUDEV=y
BR2_TARGET_GENERIC_GETTY_PORT="hvc0"
BR2_ROOTFS_OVERLAY="overlay"
BR2_LINUX_KERNEL=y
BR2_LINUX_KERNEL_CUSTOM_GIT=y
BR2_LINUX_KERNEL_CUSTOM_REPO_URL="git://github.com/open-power/linux.git"
BR2_LINUX_KERNEL_CUSTOM_REPO_VERSION="1444a4e78a9ce324b0b6ac243ccfbfc8fce25d7e"
BR2_LINUX_KERNEL_USE_CUSTOM_CONFIG=y
BR2_LINUX_KERNEL_CUSTOM_CONFIG_FILE="configs/linux/openpower_defconfig"
BR2_LINUX_KERNEL_VMLINUX=y
BR2_PACKAGE_BUSYBOX_SHOW_OTHERS=y
BR2_PACKAGE_LINUX_FIRMWARE=y
BR2_PACKAGE_LINUX_FIRMWARE_BNX2X=y
BR2_PACKAGE_LINUX_FIRMWARE_CXGB4=y
BR2_PACKAGE_PCIUTILS=y
BR2_PACKAGE_DROPBEAR=y
# BR2_PACKAGE_DROPBEAR_SERVER is not set
BR2_PACKAGE_ETHTOOL=y
BR2_PACKAGE_LLDPD=y
BR2_PACKAGE_NETCAT=y
BR2_PACKAGE_RSYNC=y
BR2_PACKAGE_IPMITOOL=y
BR2_TARGET_ROOTFS_CPIO_XZ=y
BR2_TARGET_ROOTFS_INITRAMFS=y
```

## package/lldpd/Config.in
```kconfig
config BR2_PACKAGE_LLDPD
	bool "lldpd"
	help
	  lldpd is an ISC-licensed implementation of LLDP for various Unixes.
	  It also supports some proprietary protocols.

          http://vincentbernat.github.io/lldpd/
```
